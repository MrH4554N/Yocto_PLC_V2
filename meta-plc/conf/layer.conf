## meta-plc/conf/layer.conf
```bitbake
# We have a conf and classes directory, add to BBPATH
BBPATH .= ":${LAYERDIR}"

# We have recipes-* directories, add to BBFILES
BBFILES += "${LAYERDIR}/recipes-*/*/*.bb \
            ${LAYERDIR}/recipes-*/*/*.bbappend"

BBFILE_COLLECTIONS += "meta-plc"
BBFILE_PATTERN_meta-plc = "^${LAYERDIR}/"
BBFILE_PRIORITY_meta-plc = "6"

LAYERDEPENDS_meta-plc = "core"
LAYERSERIES_COMPAT_meta-plc = "walnascar"
WKS_SEARCH_PATH .= ":${LAYERDIR}/recipes-core/images/wic"
```
